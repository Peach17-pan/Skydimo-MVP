## 10_LVGL_V9_Test/sdkconfig.defaults
```kconfig
# LVGL配置
CONFIG_LV_MEM_CUSTOM=y
CONFIG_LV_MEM_CUSTOM_INCLUDE="stdlib.h"
CONFIG_LV_USE_STDLIB_MALLOC=y
CONFIG_LV_USE_STDLIB_STRING=y
CONFIG_LV_USE_STDLIB_SPRINTF=y
CONFIG_LV_TICK_CUSTOM=y
CONFIG_LV_TICK_CUSTOM_INCLUDE="esp_timer.h"
CONFIG_LV_TICK_CUSTOM_SYS_TIME_EXPR=(esp_timer_get_time() / 1000)

# PSRAM配置
CONFIG_SPIRAM=y
CONFIG_SPIRAM_MODE_OCT=y
CONFIG_SPIRAM_SPEED_80M=y
CONFIG_LV_MEM_SIZE_KILOBYTES=64

# I2C配置
CONFIG_I2C_ISR_IN_IRAM=n

# FreeRTOS
CONFIG_FREERTOS_HZ=1000
CONFIG_FREERTOS_ENABLE_BACKWARD_COMPATIBILITY=y
```

## ESP32_Projects/Skydimo_T1/sdkconfig.defaults
```kconfig
CONFIG_IDF_TARGET="esp32s3"
CONFIG_ESP32S3_DEFAULT_CPU_FREQ_240=y

CONFIG_ESP32S3_SPIRAM_SUPPORT=y
CONFIG_SPIRAM_MODE_OCT=y
CONFIG_SPIRAM_SPEED_80M=y
CONFIG_SPIRAM_BOOT_INIT=y
CONFIG_SPIRAM_USE_MALLOC=y
CONFIG_SPIRAM_MEMTEST=y
CONFIG_SPIRAM_USE_CAPS_ALLOC=y
CONFIG_SPIRAM_ALLOW_BSS_SEG_EXTERNAL_MEMORY=n


CONFIG_LCD_DISABLE_I2C_PLL=n
CONFIG_LCD_DSI_CLK_160M=y
CONFIG_LCD_ENABLE_480x172=y


CONFIG_ESP_CONSOLE_UART_DEFAULT=y
CONFIG_ESP_CONSOLE_UART_NUM=0
CONFIG_ESP_CONSOLE_UART_BAUDRATE=115200


CONFIG_BT_ENABLED=n
CONFIG_BTDM_CTRL_MODE_BLE_ONLY=y
CONFIG_BTDM_CTRL_MODE_BR_EDR_ONLY=n
CONFIG_BTDM_CTRL_MODE_BTDM=n
```

## examples/examples/sdkconfig.defaults
```kconfig
# ESP32-S3 LVGL 红色全屏显示 - SDK 配置
# 由 idf.py save-defconfig 生成

# 目标芯片
CONFIG_IDF_TARGET="esp32s3"

# Flash 配置
CONFIG_ESPTOOLPY_FLASHSIZE_16MB=y

# 分区表
CONFIG_PARTITION_TABLE_CUSTOM=y

# 编译器优化
CONFIG_COMPILER_OPTIMIZATION_PERF=y

# SPIRAM (PSRAM) 配置
CONFIG_SPIRAM=y
CONFIG_SPIRAM_MODE_OCT=y
CONFIG_SPIRAM_SPEED_80M=y

# FreeRTOS 配置
CONFIG_FREERTOS_HZ=1000

# LVGL 配置
CONFIG_LV_OS_FREERTOS=y
CONFIG_LV_ATTRIBUTE_FAST_MEM_USE_IRAM=y

# LVGL 字体
CONFIG_LV_FONT_MONTSERRAT_12=y
CONFIG_LV_FONT_MONTSERRAT_16=y
```
